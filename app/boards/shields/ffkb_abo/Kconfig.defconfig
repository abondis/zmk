## app/boards/shields/ffkb_abo/Kconfig.defconfig
```kconfig
# Copyright (c) 2021 The ZMK Contributors
# SPDX-License-Identifier: MIT

if SHIELD_FFKB

config ZMK_KEYBOARD_NAME
    default "ffkb_abo"

config I2C
	default y

CONFIG_BUILD_OUTPUT_UF2=y

endif
```
